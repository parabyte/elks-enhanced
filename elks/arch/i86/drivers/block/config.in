## elks/arch/i86/drivers/block/config.in
```kconfig
#
# Block device driver configuration
#
mainmenu_option next_comment
    comment 'Block device drivers'

	bool '  BIOS floppy drive support'	CONFIG_BLK_DEV_BFD	y
	bool '  Direct hw floppy support'	CONFIG_BLK_DEV_FD	n
	bool '  Floppy drive track caching'	CONFIG_TRACK_CACHE	y
	bool '  BIOS preset floppy types'	CONFIG_BLK_DEV_BFD_HARD n
	bool '  BIOS hard drive support'	CONFIG_BLK_DEV_BHD	y
	bool '  IDE hard drive CHS probe'	CONFIG_IDE_PROBE	y
	if [ "$CONFIG_BLK_DEV_FD" == "y" ]; then
		define_bool CONFIG_ASYNCIO y
	fi

	comment 'Additional block devices'

	bool 'RAM disk support'			CONFIG_BLK_DEV_RAM	y
	if [ "$CONFIG_BLK_DEV_RAM" == "y" ]; then
		hex 'Preload RAM disk segment address' CONFIG_RAMDISK_SEGMENT 0
		int 'Preload RAM disk sectors' CONFIG_RAMDISK_SECTORS 128
	fi
	choice 'SSD disk driver' \
		"None CONFIG_BLK_DEV_SSD_NONE \
		Test CONFIG_BLK_DEV_SSD_TEST \
		SDCard CONFIG_BLK_DEV_SSD_SD" None

	if [ "$CONFIG_BLK_DEV_SSD_SD" == "y" ] && [ "$CONFIG_ARCH_NECV25" == "y" ]; then
      bool 'Interface SD card with hardware SPI'	CONFIG_HW_SPI	y
	fi

	bool 'ATA-CF/IDE drive support'	        CONFIG_BLK_DEV_ATA_CF	n
	if [ "$CONFIG_BLK_DEV_ATA_CF" == "y" ]; then
		int '  ATA/XTIDE default mode (-1 auto, 0 ATA, 1 XTIDEv1, 2 XTIDEv2, 3 XTCF, 4 SOLO86)' CONFIG_ATA_MODE_DEFAULT -1
		hex '  Standard ATA base I/O port' CONFIG_ATA_BASE_PORT 0x1F0
		hex '  XTIDE/XTCF base I/O port' CONFIG_ATA_XTIDE_BASE_PORT 0x300
		hex '  SOLO/86 ATA base I/O port' CONFIG_ATA_SOLO86_BASE_PORT 0x40
		bool '  ATAPI CD-ROM packet support' CONFIG_ATA_ATAPI y
		bool '  Flush ATA write cache on final close' CONFIG_ATA_FLUSH_CACHE y
	fi

	bool 'XT MFM hard drive support' CONFIG_BLK_DEV_MFMHD n
	if [ "$CONFIG_BLK_DEV_MFMHD" == "y" ]; then
		hex '  Primary MFM I/O port' CONFIG_MFMHD_PRIMARY_PORT 0x320
		hex '  Secondary MFM I/O port' CONFIG_MFMHD_SECONDARY_PORT 0x324
		int '  MFM drives to probe' CONFIG_MFMHD_ACTIVE_DRIVES 2
		choice '  MFM controller profile' \
			"WD1002A-WX1 CONFIG_MFMHD_CTRL_WD1002 \
			Seagate-ST11-FileCard CONFIG_MFMHD_CTRL_SEAGATE" WD1002A-WX1
		if [ "$CONFIG_MFMHD_CTRL_WD1002" == "y" ]; then
			choice '  WD1002A-WX1 BIOS geometry table' \
				"Super CONFIG_MFMHD_BIOS_SUPER \
				G CONFIG_MFMHD_BIOS_G \
				H CONFIG_MFMHD_BIOS_H" Super
		fi
		int '  Command step-rate code' CONFIG_MFMHD_STEP_CODE 0
		int '  Drive 0 cylinders override (0 uses controller)' CONFIG_MFMHD_DRIVE0_CYLINDERS 0
		int '  Drive 0 heads override (0 uses controller)' CONFIG_MFMHD_DRIVE0_HEADS 0
		int '  Drive 0 sectors override (0 uses controller)' CONFIG_MFMHD_DRIVE0_SECTORS 0
		int '  Drive 1 cylinders override (0 uses controller)' CONFIG_MFMHD_DRIVE1_CYLINDERS 0
		int '  Drive 1 heads override (0 uses controller)' CONFIG_MFMHD_DRIVE1_HEADS 0
		int '  Drive 1 sectors override (0 uses controller)' CONFIG_MFMHD_DRIVE1_SECTORS 0
		bool '  Maintenance ioctls (diagnostic/format/control)' CONFIG_MFMHD_DIAG_IOCTLS n
		bool '  Trace MFM command handshakes' CONFIG_MFMHD_TRACE n
	fi

    comment 'Block device options'
    bool 'Character access to block devices'	CONFIG_BLK_DEV_CHAR	y
endmenu
```

## elks/arch/i86/drivers/char/config.in
```kconfig
#
# Character device driver configuration
#

mainmenu_option next_comment
	comment 'Character device drivers'

	choice 'Select console driver'			\
		"Direct         CONFIG_CONSOLE_DIRECT	\
		 BIOS           CONFIG_CONSOLE_BIOS	\
		 8018x		CONFIG_CONSOLE_8018X 	\
		 NECV25		CONFIG_CONSOLE_NECV25 	\
		 Headless       CONFIG_CONSOLE_HEADLESS"	Direct
	if [ "$CONFIG_CONSOLE_DIRECT" = "y" ]; then
		if [ "$CONFIG_ARCH_SWAN" = "y" ]; then
			choice 'Console font'			\
				"8x8   CONFIG_CONSOLE_FONT_8X8  \
				4x8    CONFIG_CONSOLE_FONT_4X8" 4x8
		fi
		bool '  Scancode keyboard driver'	CONFIG_KEYBOARD_SCANCODE y
		bool '  Dual-screen console support'    CONFIG_CONSOLE_DUAL n
	fi
	bool 'Serial Console'	CONFIG_CONSOLE_SERIAL		n
	if [[ "$CONFIG_CONSOLE_DIRECT" = "y" || "$CONFIG_CONSOLE_BIOS" = "y" ]]; then
	        bool 'Console ANSI terminal emulation'  CONFIG_EMUL_ANSI  y
	fi
	if [ "$CONFIG_CONSOLE_DIRECT" = "y" ]; then
		source elks/arch/i86/drivers/char/KeyMaps/config.in
	fi

	comment 'Other character devices'
	if [ "$CONFIG_CONSOLE_SERIAL" = "n" ]; then
		bool 'Serial device driver'	CONFIG_CHAR_DEV_RS	  y
	else
		define_bool CONFIG_CHAR_DEV_RS y
	fi
	bool 'Parallel device driver'		CONFIG_CHAR_DEV_LP	  y
	if [ "$CONFIG_ARCH_IBMPC" = "y" ]; then
		bool 'ISA 8-bit DMA audio (/dev/dsp, SB-compatible)'	CONFIG_CHAR_DEV_DSP	  n
		if [ "$CONFIG_CHAR_DEV_DSP" = "y" ]; then
			comment '  /bootopts: sb=0x220,5,1 or sb=off; mad16=on for OPTi 82C929'
			hex '  SB base I/O port' CONFIG_SB_PORT 0x220
			int '  SB hardware IRQ' CONFIG_SB_IRQ 5
			int '  SB 8-bit DMA only (channel 1 or 3)' CONFIG_SB_DMA 1
			int '  SB DMA bounce buffer bytes' CONFIG_SB_BOUNCE 4096
			bool '  SB Pro 8-bit stereo playback' CONFIG_SB_STEREO n
		fi
	fi
	#bool 'CGA text mode videobuffer'	CONFIG_CHAR_DEV_CGATEXT	  n
	bool 'Memory character devices'		CONFIG_CHAR_DEV_MEM	  y
	if [ "$CONFIG_CHAR_DEV_MEM" = "y" ]; then
		bool '  /dev/port read (inb)'	CONFIG_CHAR_DEV_MEM_PORT_READ	y
		bool '  /dev/port write (outb)'	CONFIG_CHAR_DEV_MEM_PORT_WRITE	y
	fi

	bool 'Pseudo tty device driver'		CONFIG_PSEUDO_TTY	  y
endmenu
```

## elkscmd/config.in
```kconfig
#
# ELKS Commands configuration menu
#

mainmenu_option next_comment
	comment 'Userland'

	bool 'Select Applications by Image Size'	CONFIG_APPS_BY_IMAGESZ	n
	if [ "$CONFIG_APPS_BY_IMAGESZ" == "n" ]; then

		comment "Shell"

		bool 'ash'        CONFIG_APP_ASH        y
		bool 'sash'       CONFIG_APP_SASH       y

		comment 'Applications'

		busyelks 'diskutils'	CONFIG_APP_DISK_UTILS	y
		busyelks 'fileutils'	CONFIG_APP_FILE_UTILS	y
		busyelks 'shutils'	 	CONFIG_APP_SH_UTILS		y
		bool 'sysutils'			CONFIG_APP_SYS_UTILS	y
		bool 'vi'      			CONFIG_APP_ELVIS		y
		busyelks 'minix1'		CONFIG_APP_MINIX1		y
		bool 'minix2'			CONFIG_APP_MINIX2		y
		busyelks 'minix3'		CONFIG_APP_MINIX3		y
		busyelks 'miscutils'	CONFIG_APP_MISC_UTILS	y
		bool 'Text UI'			CONFIG_APP_TUI  		y
		bool 'BASIC'			CONFIG_APP_BASIC		y
		bool 'screen'     		CONFIG_APP_SCREEN       y
		bool 'cron'           	CONFIG_APP_CRON        	y
		bool 'other'         	CONFIG_APP_OTHER        y
		bool 'test'       		CONFIG_APP_TEST         n
		bool 'busyelks'			CONFIG_APP_BUSYELKS		n
		string 'Additional TAG string for app selection'  CONFIG_APP_TAGS      ''

		#comment 'Commands not compiling'
		#bool 'levee'			CONFIG_APP_LEVEE      n
		#bool 'xvi'        		CONFIG_APP_XVI        n

		comment "Internet stack and utilities"

		if [ "$CONFIG_INET" == "y" ]; then
			if [ "$CONFIG_APPS_BY_IMAGESZ" == "n" ]; then
			bool 'uIP userspace stack' CONFIG_APP_UIP y
		else
			comment '(uIP binaries selected by image size)'
		fi
			int 'uIP packet buffer size' CONFIG_UIP_BUFFER_SIZE 1514
			int 'uIP TCP connections' CONFIG_UIP_MAX_CONNECTIONS 16
			int 'uIP listen ports' CONFIG_UIP_MAX_LISTENPORTS 10
			bool 'uIP UDP support' CONFIG_UIP_UDP y
			if [ "$CONFIG_UIP_UDP" == "y" ]; then
				bool 'uIP IP broadcast receive' CONFIG_UIP_BROADCAST y
				int 'uIP UDP connections' CONFIG_UIP_UDP_CONNS 8
				bool 'uIP DHCP client' CONFIG_UIP_DHCPC y
				if [ "$CONFIG_UIP_DHCPC" == "y" ]; then
					bool 'uIP DHCP light mode' CONFIG_UIP_DHCP_LIGHT y
				fi
				bool 'uIP DNS resolver framework' CONFIG_UIP_RESOLV y
				if [ "$CONFIG_UIP_RESOLV" == "y" ]; then
					int 'uIP resolver cache entries' CONFIG_UIP_RESOLV_ENTRIES 4
				fi
			fi
		else
			comment '(uIP needs TCP/IP sockets)'
		fi

		comment 'Man pages'

		bool 'Man Pages'      		CONFIG_APP_MAN_PAGES  n
	else
		comment "Select Applications by Image Size"

		choice 'Apps and Image Size' \
		"ALL-HD      	CONFIG_APPS_HD   	\
		 Large-2880k	CONFIG_APPS_2880K	\
		 Large-1440k	CONFIG_APPS_1440K	\
		 PC98-1232k     CONFIG_APPS_1232K	\
		 Medium-1200k	CONFIG_APPS_1200K	\
		 Medium-720k	CONFIG_APPS_720K	\
		 Small-360k		CONFIG_APPS_360K" Large-1440k
	fi
	if [ "$CONFIG_INET" == "y" ]; then
		comment "External Network Applications"
		bool 'Dropbear SSH client (external repo)' CONFIG_APP_DROPBEAR n
		bool 'BearSSL tlsget client (external repo)' CONFIG_APP_BEARSSL n
	fi
	comment "System startup"

	bool 'Use sash as default shell'		CONFIG_SYS_DEFSHELL_SASH n
	bool 'Run /bin/sh as init'				CONFIG_SYS_NO_BININIT n

endmenu
```
